#ifndef ICONS_H
#define ICONS_H

#include <pgmspace.h>
#include "esp_log.h"

namespace Icons
{
    // Add tag for ESP logging
    static const char* TAG = "Icons";

    // Icon dimensions
    enum class Size
    {
        SMALL = 32,
        LARGE = 64
    };

    // Icon types
    enum class Type
    {
        FOX_1,
        FOX_2,
        FOX_3
    };

    // Icon polarity
    enum class Polarity
    {
        POSITIVE,
        NEGATIVE
    };

    // Structure to hold icon metadata
    struct IconInfo
    {
        const unsigned char *data;
        Size size;
        Type type;
        Polarity polarity;
        u8g2_uint_t width;
        u8g2_uint_t height;
    };

    // Original image data (kept as-is)
    // 'fox_5605972 (2)', 32x32px
    const unsigned char epd_bitmap_fox_32x32_1_p[] U8X8_PROGMEM = {
        0x00, 0x00, 0x00, 0x00, 0x00, 0x00, 0xc0, 0x0c, 0x00, 0x01, 0x20, 0x10, 0x00, 0x02, 0xa8, 0x2c,
        0x00, 0x02, 0x14, 0x44, 0x00, 0x01, 0x13, 0x70, 0x00, 0x05, 0x00, 0x0c, 0x00, 0x00, 0x10, 0x04,
        0x00, 0x04, 0xa0, 0x04, 0x00, 0x02, 0x80, 0x02, 0x00, 0x00, 0x48, 0x02, 0x00, 0x01, 0x04, 0x0a,
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        0x07, 0x84, 0x12, 0x80, 0x00, 0x02, 0x11, 0x00, 0x00, 0x00, 0x19, 0x80, 0x00, 0x00, 0x00, 0x00};

    const unsigned char epd_bitmap_fox_32x32_2_p[] U8X8_PROGMEM = {
        0x00, 0x00, 0x00, 0x00, 0x00, 0x00, 0xc0, 0x0c, 0x00, 0x01, 0x50, 0x14, 0x00, 0x02, 0xa8, 0x2c,
        0x00, 0x02, 0x94, 0x50, 0x00, 0x02, 0x13, 0xf4, 0x00, 0x03, 0x14, 0x0c, 0x00, 0x04, 0x10, 0x94,
        0x00, 0x02, 0xa5, 0x04, 0x00, 0x02, 0xd0, 0x52, 0x00, 0x01, 0x15, 0x0a, 0x00, 0x01, 0x4c, 0x54,
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        0x06, 0x85, 0x19, 0x80, 0x00, 0x02, 0x11, 0x00, 0x00, 0x00, 0x19, 0x80, 0x00, 0x00, 0x00, 0x00};
    // 'fox_5606000 (1)', 64x64px
    const unsigned char epd_bitmap_fox_64x64_1_p[] U8X8_PROGMEM = {
        0x00, 0x00, 0x00, 0x00, 0x00, 0x00, 0x00, 0x00, 0x00, 0x00, 0x00, 0x00, 0xc0, 0x00, 0x00, 0x30,
        0x00, 0x00, 0x00, 0x00, 0xb0, 0x00, 0x00, 0x70, 0x00, 0x00, 0x00, 0x01, 0x98, 0x00, 0x01, 0x90,
        0x00, 0x00, 0x00, 0x03, 0x4e, 0x00, 0x03, 0x50, 0x00, 0x00, 0x00, 0x02, 0x73, 0x00, 0x06, 0xb0,
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        0x00, 0x00, 0x00, 0x00, 0x01, 0xa0, 0xc0, 0x00, 0x00, 0x00, 0x00, 0x00, 0x10, 0x00, 0x00, 0x00};

    const unsigned char epd_bitmap_fox_32x32_1_n[] U8X8_PROGMEM = {
        0x00, 0x00, 0x00, 0x00, 0x00, 0x00, 0xc0, 0x0c, 0x00, 0x01, 0x20, 0x10, 0x00, 0x02, 0xa8, 0x2c,
        0x00, 0x02, 0x14, 0x44, 0x00, 0x01, 0x13, 0x70, 0x00, 0x05, 0x00, 0x0c, 0x00, 0x00, 0x10, 0x04,
        0x00, 0x04, 0xa0, 0x04, 0x00, 0x02, 0x80, 0x02, 0x00, 0x00, 0x48, 0x02, 0x00, 0x01, 0x04, 0x0a,
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        0x07, 0x84, 0x12, 0x80, 0x00, 0x02, 0x11, 0x00, 0x00, 0x00, 0x19, 0x80, 0x00, 0x00, 0x00, 0x00};
    // 'fox_5606000', 32x32px
    const unsigned char epd_bitmap_fox_32x32_2_n[] U8X8_PROGMEM = {
        0x00, 0x00, 0x00, 0x00, 0x00, 0x00, 0xc0, 0x0c, 0x00, 0x01, 0x50, 0x14, 0x00, 0x02, 0xa8, 0x2c,
        0x00, 0x02, 0x94, 0x50, 0x00, 0x02, 0x13, 0xf4, 0x00, 0x03, 0x14, 0x0c, 0x00, 0x04, 0x10, 0x94,
        0x00, 0x02, 0xa5, 0x04, 0x00, 0x02, 0xd0, 0x52, 0x00, 0x01, 0x15, 0x0a, 0x00, 0x01, 0x4c, 0x54,
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        0x06, 0x85, 0x19, 0x80, 0x00, 0x02, 0x11, 0x00, 0x00, 0x00, 0x19, 0x80, 0x00, 0x00, 0x00, 0x00};
    // 'fox_5606000 (1)', 64x64px
    const unsigned char epd_bitmap_fox_64x64_1_n[] U8X8_PROGMEM = {
        0x00, 0x00, 0x00, 0x00, 0x00, 0x00, 0x00, 0x00, 0x00, 0x00, 0x00, 0x00, 0xc0, 0x00, 0x00, 0x30,
        0x00, 0x00, 0x00, 0x00, 0xb0, 0x00, 0x00, 0x70, 0x00, 0x00, 0x00, 0x01, 0x98, 0x00, 0x01, 0x90,
        0x00, 0x00, 0x00, 0x03, 0x4e, 0x00, 0x03, 0x50, 0x00, 0x00, 0x00, 0x02, 0x73, 0x00, 0x06, 0xb0,
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        0x00, 0x00, 0x00, 0x00, 0x01, 0xa0, 0xc0, 0x00, 0x00, 0x00, 0x00, 0x00, 0x10, 0x00, 0x00, 0x00};

    // Keep all other existing image data...
    // ... (your existing image data stays exactly the same) ...

    // Helper array containing all icons with metadata
    const IconInfo ICONS[] = {
        {epd_bitmap_fox_32x32_1_p, Size::SMALL, Type::FOX_1, Polarity::POSITIVE, 32, 32},
        {epd_bitmap_fox_32x32_2_p, Size::SMALL, Type::FOX_2, Polarity::POSITIVE, 32, 32},
        {epd_bitmap_fox_64x64_1_p, Size::LARGE, Type::FOX_3, Polarity::POSITIVE, 64, 64},
        {epd_bitmap_fox_32x32_1_n, Size::SMALL, Type::FOX_1, Polarity::NEGATIVE, 32, 32},
        {epd_bitmap_fox_32x32_2_n, Size::SMALL, Type::FOX_2, Polarity::NEGATIVE, 32, 32},
        {epd_bitmap_fox_64x64_1_n, Size::LARGE, Type::FOX_3, Polarity::NEGATIVE, 64, 64}
    };

    // Helper functions
    inline const IconInfo *getIcon(Type type, Polarity polarity = Polarity::POSITIVE)
    {
        ESP_LOGD(TAG, "Getting icon - Type: %d, Polarity: %d", 
                 static_cast<int>(type), static_cast<int>(polarity));
        
        for (const auto &icon : ICONS)
        {
            if (icon.type == type && icon.polarity == polarity)
            {
                ESP_LOGD(TAG, "Found matching icon - Size: %dx%d", 
                         icon.width, icon.height);
                return &icon;
            }
        }
        ESP_LOGW(TAG, "No matching icon found");
        return nullptr;
    }

    inline const IconInfo *getIconBySize(Size size, Polarity polarity = Polarity::POSITIVE)
    {
        ESP_LOGD(TAG, "Getting icon by size - Size: %d, Polarity: %d",
                 static_cast<int>(size), static_cast<int>(polarity));
        
        for (const auto &icon : ICONS)
        {
            if (icon.size == size && icon.polarity == polarity)
            {
                ESP_LOGD(TAG, "Found matching icon - Size: %dx%d",
                         icon.width, icon.height);
                return &icon;
            }
        }
        ESP_LOGW(TAG, "No matching icon found for size");
        return nullptr;
    }

    inline const IconInfo *getAllIcons()
    {
        ESP_LOGD(TAG, "Getting all icons array");
        return ICONS;
    }

    inline size_t getIconCount()
    {
        size_t count = sizeof(ICONS) / sizeof(ICONS[0]);
        ESP_LOGD(TAG, "Getting icon count: %d", count);
        return count;
    }

    inline int getSizePixels(Size size)
    {
        int pixels = static_cast<int>(size);
        ESP_LOGD(TAG, "Converting size enum to pixels: %d", pixels);
        return pixels;
    }

    // Keep compatibility with old code
    const int epd_bitmap_foxes_positive_array_LEN = 3;
    const unsigned char *epd_bitmap_foxes_positive_array[3] = {
        epd_bitmap_fox_32x32_1_p,
        epd_bitmap_fox_32x32_2_p,
        epd_bitmap_fox_64x64_1_p};

    const int epd_bitmap_foxes_negative_array_LEN = 3;
    const unsigned char *epd_bitmap_foxes_negative_array[3] = {
        epd_bitmap_fox_32x32_1_n,
        epd_bitmap_fox_32x32_2_n,
        epd_bitmap_fox_64x64_1_n};

    // Conversion utilities
    inline void convertToXBM(const unsigned char* input, unsigned char* output, 
                            u8g2_uint_t width, u8g2_uint_t height) 
    {
        ESP_LOGD(TAG, "Converting bitmap to XBM format - Size: %dx%d", width, height);
        
        size_t bytes = (width * height + 7) / 8;
        for (size_t i = 0; i < bytes; i++) 
        {
            // XBM format requires bits to be reversed within each byte
            unsigned char byte = input[i];
            unsigned char reversed = 0;
            
            // Reverse the bits
            for (int b = 0; b < 8; b++) 
            {
                reversed = (reversed << 1) | (byte & 1);
                byte >>= 1;
            }
            
            output[i] = reversed;
        }
        ESP_LOGD(TAG, "Bitmap conversion completed - Processed %d bytes", bytes);
    }

    // Get icon in XBM format
    inline const IconInfo getIconXBM(Type type, Polarity polarity = Polarity::POSITIVE) 
    {
        ESP_LOGD(TAG, "Getting icon in XBM format - Type: %d, Polarity: %d",
                 static_cast<int>(type), static_cast<int>(polarity));
        
        const IconInfo* originalIcon = getIcon(type, polarity);
        if (!originalIcon) {
            ESP_LOGE(TAG, "Failed to get original icon for XBM conversion");
            return IconInfo{nullptr, Size::SMALL, type, polarity, 0, 0};
        }

        // Calculate buffer size
        size_t bufferSize = (originalIcon->width * originalIcon->height + 7) / 8;
        
        // Allocate buffer for converted data
        unsigned char* convertedData = new unsigned char[bufferSize];
        if (!convertedData) {
            ESP_LOGE(TAG, "Failed to allocate memory for XBM conversion");
            return IconInfo{nullptr, Size::SMALL, type, polarity, 0, 0};
        }

        // Convert the bitmap
        convertToXBM(originalIcon->data, convertedData, 
                    originalIcon->width, originalIcon->height);
        
        ESP_LOGD(TAG, "XBM conversion successful - Buffer size: %d bytes", bufferSize);

        // Return new IconInfo with converted data
        return IconInfo{
            convertedData,
            originalIcon->size,
            originalIcon->type,
            originalIcon->polarity,
            originalIcon->width,
            originalIcon->height
        };
    }

    // Helper to clean up converted XBM data
    inline void freeXBMData(const IconInfo& iconInfo) 
    {
        ESP_LOGD(TAG, "Freeing XBM converted data");
        if (iconInfo.data != nullptr) {
            delete[] iconInfo.data;
            ESP_LOGD(TAG, "XBM data freed successfully");
        }
    }

    // Smart wrapper class for XBM icons
    class XBMIcon {
    private:
        IconInfo icon;

    public:
        // Constructor that immediately converts to XBM
        XBMIcon(Type type, Polarity polarity = Polarity::POSITIVE) {
            icon = getIconXBM(type, polarity);
        }

        // Destructor automatically frees memory
        ~XBMIcon() {
            if (icon.data) {
                freeXBMData(icon);
            }
        }

        // Prevent copying to avoid double-free
        XBMIcon(const XBMIcon&) = delete;
        XBMIcon& operator=(const XBMIcon&) = delete;

        // Allow checking if conversion was successful
        bool isValid() const { return icon.data != nullptr; }

        // Getters for the icon properties
        const unsigned char* data() const { return icon.data; }
        u8g2_uint_t width() const { return icon.width; }
        u8g2_uint_t height() const { return icon.height; }
    };
}

#endif